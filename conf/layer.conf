## conf/layer.conf
```bitbake
# We have a conf and classes directory, add to BBPATH
BBPATH .= ":${LAYERDIR}"
# We have recipes-* directories, add to BBFILES
BBFILES += "${LAYERDIR}/recipes-*/*/*.bb ${LAYERDIR}/recipes*/*/*.bbappend"

BBFILE_COLLECTIONS += "pitft35-rpi"
BBFILE_PATTERN_pitft35-rpi = "^${LAYERDIR}/"
BBFILE_PRIORITY_pitft35-rpi = "7"
```
